## boards/qemu/qemu_coursedev/Kconfig.defconfig
```kconfig
# SPDX-License-Identifier: Apache-2.0
# Board-level default configuration for qemu_coursedev.

if BOARD_QEMU_COURSEDEV

config BUILD_OUTPUT_BIN
	default n

config HAS_COVERAGE_SUPPORT
	default y

config QEMU_ICOUNT_SHIFT
	default 6 if QEMU_ICOUNT

endif # BOARD_QEMU_COURSEDEV
```

## west.yml
```yaml
manifest:
  version: 1.0

  projects:
    - name: zephyr
      url: https://github.com/zephyrproject-rtos/zephyr
      revision: v4.2.0
      import:
        name-allowlist:
          - cmsis_6
          - hal_stm32
          - hal_espressif
          - hal_esp32
        path-prefix: deps
```
