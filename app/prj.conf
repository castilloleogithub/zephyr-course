## CMakeLists.txt
```
cmake_minimum_required(VERSION 3.20.0)

find_package(Zephyr REQUIRED)
project(my_zephyr_app)

target_sources(app PRIVATE src/main.c src/led_sensor.c src/sensor_cmd.c)
target_include_directories(app PRIVATE include)
```

## Kconfig
```
# Application-level Kconfig root.
# Sourcing Kconfig.zephyr pulls in the full Zephyr configuration tree,
# after which we layer the application-specific LED menu on top.

source "Kconfig.zephyr"

menuconfig LED_SUBSYSTEM
	bool "LED Subsystem"
	default y

if LED_SUBSYSTEM

choice LED_BLINK_SLEEP_TIME
	prompt "LED blink sleep time"
	default LED_BLINK_TIME_1S_MED

config LED_BLINK_TIME_05_FAST
	bool "0.5s (fast)"

config LED_BLINK_TIME_1S_MED
	bool "1s (medium)"

config LED_BLINK_TIME_2S_SLOW
	bool "2s (slow)"

endchoice

# Hidden companion of the choice above: the choice only selects *which*
# option is active, so this symbol maps that option to a value in ms.
# No prompt => it never shows up in menuconfig, it is just computed.
config LED_BLINK_SLEEP_TIME_MS
	int
	default 500 if LED_BLINK_TIME_05_FAST
	default 1000 if LED_BLINK_TIME_1S_MED
	default 2000 if LED_BLINK_TIME_2S_SLOW

menuconfig LED_ADVANCED_SETTINGS
	bool "Advanced LED settings"
	default n

if LED_ADVANCED_SETTINGS

config LED_BRIGHTNESS
	int "LED brightness (0-100)"
	default 100
	range 0 100

config LED_FADE_DURATION
	int "LED fade duration (ms)"
	default 500
	range 0 5000

menu "Expert settings"

config LED_DEBUG
	bool "Enable LED debugging"

config LED_CUSTOM_BLINK_PATTERN
	bool "Custom blink pattern"

endmenu # Expert settings

endif # LED_ADVANCED_SETTINGS

endif # LED_SUBSYSTEM

config APP_HEARTBEAT_PERIOD_MS
	int "Heartbeat LED blink period (ms)"
	default 500
	range 100 2000
	help
	Period of the application heartbeat LED, in milliseconds. The LED
	toggles once per period, so a 500 ms period gives a 1 Hz blink.
```

## prj.conf
```kconfig
CONFIG_GPIO=y
CONFIG_LOG=y

# L6: custom sensor driver
CONFIG_SENSOR=y

# L7: custom shell commands
CONFIG_SHELL=y
```

## app.overlay
```dts
/*
 * Application devicetree overlay.
 *
 * Adds an "app-led" alias pointing at the same LED node that the board
 * exposes as "led0". On this board led0 aliases the node label
 * "blue_led_0", so app-led must reference that label directly (devicetree
 * aliases are properties of /aliases and cannot be chained with &led0).
 *
 * The application code uses DT_ALIAS(app_led), so porting to another board
 * only requires updating this mapping to that board's LED node label.
 */
/ {
	aliases {
		app-led = &blue_led_0;
	};
};
```

## src/main.c
```c
/*
 * L6-task1: use the custom LED sensor driver from main.
 *
 * sensor_sample_fetch() turns the LED ON, sensor_channel_get() turns it OFF.
 */

#include <zephyr/kernel.h>
#include <zephyr/device.h>
#include <zephyr/drivers/gpio.h>
#include <zephyr/drivers/sensor.h>
#include <zephyr/sys/printk.h>

#include "led_sensor.h"

int main(void)
{
	const struct device *sensor = led_sensor_get_device();
	struct sensor_value val;
	int ret;

	if (!device_is_ready(sensor)) {
		printk("LED sensor device is not ready\n");
		return -ENODEV;
	}

	printk("Hello World! %s\n", CONFIG_BOARD);
	printk("LED sensor driver: %s\n", sensor->name);

	/* L6-task2: call the custom extension API from main.
	 * It changes the "brightness" parameter in the driver's
	 * dynamic data structure (struct led_sensor_data).
	 */
	uint8_t brightness;

	ret = led_sensor_set_brightness(sensor, 50);
	if (ret != 0) {
		printk("led_sensor_set_brightness failed: %d\n", ret);
		return ret;
	}

	led_sensor_get_brightness(sensor, &brightness);
	printk("LED brightness after extension API call: %u\n", brightness);

	while (1) {
		/* Fetch a sample -> LED ON */
		ret = sensor_sample_fetch(sensor);
		if (ret != 0) {
			printk("sensor_sample_fetch failed: %d\n", ret);
			return ret;
		}

		printk("sample fetched (LED ON)\n");

		k_msleep(CONFIG_APP_HEARTBEAT_PERIOD_MS / 2);

		/* Read the sample -> LED OFF */
		ret = sensor_channel_get(sensor, SENSOR_CHAN_AMBIENT_TEMP, &val);
		if (ret != 0) {
			printk("sensor_channel_get failed: %d\n", ret);
			return ret;
		}

		printk("sample read: %d (LED OFF)\n", (int)val.val1);

		k_msleep(CONFIG_APP_HEARTBEAT_PERIOD_MS / 2);
	}

	return 0;
}
```

## src/main.cpp
```c
#include <zephyr/drivers/gpio.h>
#include <zephyr/kernel.h>
#include <zephyr/logging/log.h>

/* The devicetree node identifier for the "app-led" alias (see app.overlay). */
#define LED_NODE DT_ALIAS(app_led)

static const struct gpio_dt_spec led = GPIO_DT_SPEC_GET(LED_NODE, gpios);

LOG_MODULE_REGISTER(main, LOG_LEVEL_INF);

int main(void)
{
    bool led_state = true;

    if (!gpio_is_ready_dt(&led)) {
        LOG_ERR("LED device %s is not ready", led.port->name);
        return 0;
    }

    if (gpio_pin_configure_dt(&led, GPIO_OUTPUT_ACTIVE) < 0) {
        LOG_ERR("Failed to configure LED %s", led.port->name);
        return 0;
    }

    while (1) {
        if (gpio_pin_toggle_dt(&led) < 0) {
            LOG_ERR("Failed to toggle LED %s", led.port->name);
            return 0;
        }

        led_state = !led_state;
        LOG_INF("LED state: %s", led_state ? "ON" : "OFF");
        k_msleep(CONFIG_APP_HEARTBEAT_PERIOD_MS);
    }
    return 0;
}
```

## include/led_sensor.h
```c
/*
 * L6-task1/L6-task2: LED-based custom sensor driver.
 *
 * The driver implements the Zephyr sensor API:
 *   - sensor_sample_fetch(): turns the LED ON
 *   - sensor_channel_get(): turns the LED OFF and returns the sample value
 *
 * L6-task2 adds a custom extension API (outside the sensor_driver_api):
 *   - led_sensor_set_brightness(): changes the "brightness" parameter stored
 *     in the driver's dynamic (device) data structure
 */

#ifndef COURSE_LED_SENSOR_H_
#define COURSE_LED_SENSOR_H_

#include <zephyr/device.h>

#ifdef __cplusplus
extern "C" {
#endif

/**
 * Return the device pointer of the custom LED sensor driver.
 *
 * The driver instance is defined with DEVICE_DEFINE() in led_sensor.c.
 */
const struct device *led_sensor_get_device(void);

/**
 * L6-task2: custom extension API.
 *
 * Changes the "brightness" parameter kept in the driver's dynamic data
 * structure (struct led_sensor_data). This is a project-specific API,
 * independent of the standard sensor_driver_api.
 *
 * @param dev        LED sensor device
 * @param brightness new brightness value (0..100)
 *
 * @return 0 on success, -EINVAL on invalid value, -ENODEV if dev is NULL
 */
int led_sensor_set_brightness(const struct device *dev, uint8_t brightness);

/**
 * L6-task2: custom extension API counterpart.
 *
 * Reads the "brightness" parameter from the driver's dynamic data structure.
 *
 * @param dev        LED sensor device
 * @param brightness output location for the current brightness (0..100)
 *
 * @return 0 on success, -ENODEV/-EINVAL on error
 */
int led_sensor_get_brightness(const struct device *dev, uint8_t *brightness);

#ifdef __cplusplus
}
#endif

#endif /* COURSE_LED_SENSOR_H_ */
```

## src/led_sensor.c
```c
/*
 * L6-task1: LED-based custom sensor driver.
 *
 * Implements the sensor driver API:
 *   - sensor_sample_fetch() : sets the LED state to ON
 *   - sensor_channel_get()  : sets the LED state to OFF and returns a value
 *
 * L6-task2: custom extension API (led_sensor_set_brightness()) that changes
 * the "brightness" parameter stored in the dynamic data structure.
 */

#include <zephyr/kernel.h>
#include <zephyr/device.h>
#include <zephyr/drivers/gpio.h>
#include <zephyr/drivers/sensor.h>
#include <zephyr/logging/log.h>

#include "led_sensor.h"

LOG_MODULE_REGISTER(led_sensor, CONFIG_LOG_DEFAULT_LEVEL);

/* The LED is taken from the devicetree alias "app-led" (see app.overlay). */
#define LED_SENSOR_NODE DT_ALIAS(app_led)

/* Dynamic data structure of the driver instance (device->data). */
struct led_sensor_data {
	bool led_on;
	uint32_t sample_count;
	uint8_t brightness; /* 0..100, changed by the extension API */
};

static int led_sensor_init(const struct device *dev)
{
	const struct gpio_dt_spec *led = dev->config;
	int ret;

	if (!gpio_is_ready_dt(led)) {
		LOG_ERR("LED device not ready");
		return -ENODEV;
	}

	ret = gpio_pin_configure_dt(led, GPIO_OUTPUT_ACTIVE);
	if (ret < 0) {
		LOG_ERR("LED configure failed (%d)", ret);
		return ret;
	}

	struct led_sensor_data *data = dev->data;

	data->led_on = true;
	data->sample_count = 0U;
	data->brightness = 100U;

	LOG_DBG("LED sensor driver initialized");
	return 0;
}

/* Sensor API: a fetch turns the LED ON. */
static int led_sensor_sample_fetch(const struct device *dev,
				   enum sensor_channel chan)
{
	const struct gpio_dt_spec *led = dev->config;
	struct led_sensor_data *data = dev->data;
	int ret;

	ret = gpio_pin_set_dt(led, 1);
	if (ret < 0) {
		return ret;
	}

	data->led_on = true;
	data->sample_count++;

	return 0;
}

/* Sensor API: reading a channel turns the LED OFF. */
static int led_sensor_channel_get(const struct device *dev,
				  enum sensor_channel chan,
				  struct sensor_value *val)
{
	const struct gpio_dt_spec *led = dev->config;
	struct led_sensor_data *data = dev->data;
	int ret;

	ret = gpio_pin_set_dt(led, 0);
	if (ret < 0) {
		return ret;
	}

	data->led_on = false;

	/* Return the number of samples taken so far as the "reading". */
	val->val1 = (int64_t)data->sample_count;
	val->val2 = 0;

	return 0;
}

static const struct sensor_driver_api led_sensor_api = {
	.sample_fetch = led_sensor_sample_fetch,
	.channel_get = led_sensor_channel_get,
};

static const struct gpio_dt_spec led_spec = GPIO_DT_SPEC_GET(LED_SENSOR_NODE, gpios);

static struct led_sensor_data led_sensor_data;

DEVICE_DEFINE(led_sensor, "LED Sensor", led_sensor_init, NULL, &led_sensor_data,
	      &led_spec, POST_KERNEL, CONFIG_SENSOR_INIT_PRIORITY, &led_sensor_api);

const struct device *led_sensor_get_device(void)
{
	return DEVICE_GET(led_sensor);
}

/*
 * L6-task2: custom extension API.
 *
 * Not part of struct sensor_driver_api: it is a project-specific function
 * that changes the "brightness" parameter in the driver's dynamic data
 * structure (struct led_sensor_data, referenced by device->data).
 */
int led_sensor_set_brightness(const struct device *dev, uint8_t brightness)
{
	struct led_sensor_data *data;

	if (dev == NULL) {
		return -ENODEV;
	}

	if (brightness > 100U) {
		return -EINVAL;
	}

	data = dev->data;
	data->brightness = brightness;

	LOG_DBG("brightness set to %u", data->brightness);
	return 0;
}

int led_sensor_get_brightness(const struct device *dev, uint8_t *brightness)
{
	struct led_sensor_data *data;

	if (dev == NULL || brightness == NULL) {
		return -ENODEV;
	}

	data = dev->data;
	*brightness = data->brightness;

	return 0;
}
```

## src/sensor_cmd.c
```c
/*
 * L7-task1: custom shell root command "sensorroot" with the subcommands:
 *
 *   sensorroot fetch   -> sensor_sample_fetch()  (LED ON)
 *   sensorroot read    -> sensor_channel_get()   (LED OFF, prints value)
 *   sensorroot info    -> prints sensor device information
 *
 * L7-task2: adds the subcommand
 *
 *   sensorroot set <value> -> led_sensor_set_brightness() (extension API)
 *
 * whose argument is validated with SHELL_CMD_ARG + shell_error().
 */

#include <zephyr/kernel.h>
#include <zephyr/device.h>
#include <zephyr/drivers/sensor.h>
#include <zephyr/shell/shell.h>

#include <errno.h>
#include <stdlib.h>

#include "led_sensor.h"

static int cmd_fetch(const struct shell *sh, size_t argc, char **argv)
{
	const struct device *sensor = led_sensor_get_device();
	int ret;

	ARG_UNUSED(argc);
	ARG_UNUSED(argv);

	if (!device_is_ready(sensor)) {
		shell_error(sh, "LED sensor device is not ready");
		return -ENODEV;
	}

	ret = sensor_sample_fetch(sensor);
	if (ret != 0) {
		shell_error(sh, "sensor_sample_fetch failed (%d)", ret);
		return ret;
	}

	shell_print(sh, "sample fetched -> LED ON");

	return 0;
}

static int cmd_read(const struct shell *sh, size_t argc, char **argv)
{
	const struct device *sensor = led_sensor_get_device();
	struct sensor_value val;
	int ret;

	ARG_UNUSED(argc);
	ARG_UNUSED(argv);

	if (!device_is_ready(sensor)) {
		shell_error(sh, "LED sensor device is not ready");
		return -ENODEV;
	}

	ret = sensor_channel_get(sensor, SENSOR_CHAN_AMBIENT_TEMP, &val);
	if (ret != 0) {
		shell_error(sh, "sensor_channel_get failed (%d)", ret);
		return ret;
	}

	shell_print(sh, "sample read: %d -> LED OFF", (int)val.val1);

	return 0;
}

static int cmd_info(const struct shell *sh, size_t argc, char **argv)
{
	const struct device *sensor = led_sensor_get_device();

	ARG_UNUSED(argc);
	ARG_UNUSED(argv);

	shell_print(sh, "device     : %s", sensor->name);
	shell_print(sh, "ready      : %s", device_is_ready(sensor) ? "yes" : "no");
	shell_print(sh, "driver api : %p", (const void *)sensor->api);

	return 0;
}

/*
 * L7-task2: "sensorroot set <value>".
 *
 * Exposes the L6-task2 extension API (led_sensor_set_brightness()) as a
 * shell subcommand. Argument validation:
 *  - SHELL_CMD_ARG(..., 2, 0) makes the shell itself reject the command
 *    when the <value> argument is missing;
 *  - the value format and range are checked here and reported with
 *    shell_error().
 */
static int cmd_set(const struct shell *sh, size_t argc, char **argv)
{
	const struct device *sensor = led_sensor_get_device();
	char *endptr;
	long value;
	int ret;

	ARG_UNUSED(argc);

	/* SHELL_CMD_ARG guarantees argv[1] exists; keep a defensive check. */
	if (argc < 2 || argv[1] == NULL) {
		shell_error(sh, "usage: sensorroot set <value> (0-100)");
		return -EINVAL;
	}

	errno = 0;
	value = strtol(argv[1], &endptr, 10);
	if (errno != 0 || endptr == argv[1] || *endptr != '\0') {
		shell_error(sh, "invalid value '%s': not a number", argv[1]);
		shell_print(sh, "usage: sensorroot set <value> (0-100)");
		return -EINVAL;
	}

	if (value < 0 || value > 100) {
		shell_error(sh, "value %ld out of range: must be 0-100", value);
		return -EINVAL;
	}

	ret = led_sensor_set_brightness(sensor, (uint8_t)value);
	if (ret != 0) {
		shell_error(sh, "led_sensor_set_brightness failed (%d)", ret);
		return ret;
	}

	shell_print(sh, "brightness set to %ld", value);

	return 0;
}

/* Subcommand set of the "sensorroot" root command. */
SHELL_STATIC_SUBCMD_SET_CREATE(sensorroot_subs,
	SHELL_CMD_ARG(fetch, NULL, "Fetch a sensor sample (LED ON)", cmd_fetch, 1, 0),
	SHELL_CMD_ARG(read, NULL, "Read the sensor sample (LED OFF)", cmd_read, 1, 0),
	SHELL_CMD_ARG(info, NULL, "Show sensor device information", cmd_info, 1, 0),
	/* L7-task2: mandatory <value> argument (mandatory 1, optional 0). */
	SHELL_CMD_ARG(set, NULL, "Set LED brightness: set <value> (0-100)", cmd_set, 2, 0),
	SHELL_SUBCMD_SET_END);

/* Root command: "sensorroot". */
SHELL_CMD_ARG_REGISTER(sensorroot, &sensorroot_subs, "LED sensor root command", NULL, 1, 0);
```
